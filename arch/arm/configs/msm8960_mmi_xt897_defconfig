## arch/arm/configs/msm8960_mmi_xt897_defconfig
```kconfig
CONFIG_BUILD_ARM_APPENDED_DTB_IMAGE=y
CONFIG_BUILD_ARM_APPENDED_DTB_IMAGE_NAMES="msm8960-asanti-p2"
CONFIG_ARM_APPENDED_DTB=y
CONFIG_ARM_ATAG_DTB_COMPAT=y
CONFIG_CMDLINE_EXTEND=y
CONFIG_MMI_JB_FIRMWARE=y
```
